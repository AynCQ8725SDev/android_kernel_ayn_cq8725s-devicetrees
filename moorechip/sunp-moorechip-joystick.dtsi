#include <dt-bindings/leds/common.h>

&qupv3_hub_i2c3 {
	#address-cells = <1>;
	#size-cells = <0>;
	status = "ok";

	htr3212r@3c {
		compatible = "kona,htr3212r";
		htr3212r,dv-en2 = <&tlmm 88 0>;
		reg = <0x3c>;
		status = "ok";
	};
};

&qupv3_hub_i2c4 {
	#address-cells = <1>;
	#size-cells = <0>;
	status = "ok";

	htr3212l@3c {
		compatible = "kona,htr3212l";
		htr3212l,dv-en1 = <&tlmm 87 0>;
		reg = <0x3c>;
		status = "ok";
	};
};